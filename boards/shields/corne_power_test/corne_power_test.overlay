/* Stock nice!nano v2 power driver; settle before OLED/TPS65 initialization. */
&{/EXT_POWER} {
    status = "okay";
    init-delay-ms = <500>;
};

/* RGB data is held low by the diagnostic initializer. */
&spi3 {
    status = "disabled";
};

&led_strip {
    status = "disabled";
};
