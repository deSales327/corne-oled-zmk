## Kconfig
```kconfig
config TPS65_PROBE
    bool "TPS65 GPIO identification diagnostic"
    depends on BOARD_NICE_NANO_V2 && INPUT && LOG
    default y if SHIELD_TPS65_PROBE
```

## boards/shields/corne_power_test/Kconfig.shield
```kconfig
config SHIELD_CORNE_POWER_TEST
    def_bool $(shields_list_contains,corne_power_test)
```

## config/west.yml
```yaml
manifest:
  remotes:
    - name: zmkfirmware
      url-base: https://github.com/zmkfirmware
    - name: desales327
      url-base: https://github.com/deSales327
  projects:
    - name: zmk
      remote: zmkfirmware
      revision: v0.3.0
      import: app/west.yml
    - name: zmk-driver-azoteq-iqs5xx
      remote: desales327
      revision: e0f5e66e61e9daf961122f2f0a81be6b51b0ac9c
  self:
    path: config
```
